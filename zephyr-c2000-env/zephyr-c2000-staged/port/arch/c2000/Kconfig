## zephyr-c2000-env/zephyr-c2000-staged/port/arch/c2000/Kconfig
```kconfig
# TI TMS320C28x (C2000) architecture options
#
# NOTE: C28x has 16-bit bytes (CHAR_BIT == 16).  Subsystems that exchange
# 8-bit byte streams (networking, file systems, most protocol stacks) must
# be disabled or adapted before they can be enabled for this architecture.

menu "TI C2000 (C28x) Options"
	depends on C2000

config ARCH
	string
	default "c2000"

config NUM_IRQS
	int
	default 128

config NUM_IRQ_PRIO_LEVELS
	int
	default 1
	help
	  The C28x ePIE has a fixed hardware priority per group/interrupt,
	  so Zephyr's software priority levels are not used.  One level keeps
	  the scheduler and IRQ_CONNECT() usable.

config GEN_ISR_TABLES
	default n

config GEN_SW_ISR_TABLE
	default n

config XIP
	default y

config MAIN_STACK_SIZE
	default 1024

config INITIALIZATION_STACK_SIZE
	default 512

config SYS_CLOCK_HW_CYCLES_PER_SEC
	int
	default 200000000

config TEST_EXTRA_STACK_SIZE
	default 128

# ------------------------------------------------------------
# C2000 dual-core + CLA options
# ------------------------------------------------------------

config C2000_SMP_CPU2
	bool
	prompt "Start CPU2 secondary core"
	help
	  F2837xD is a dual-core device. Say Y here to have CPU1 boot
	  CPU2 via the IPC Boot Mode register after bring-up.  A CPU2
	  image must be linked at its own Flash/RAM addresses and provide
	  the _cpu2_boot_addr symbol; otherwise the boot is silently
	  skipped.  When disabled, CPU2 stays in reset.

config C2000_CLA1
	bool
	prompt "Enable CPU1 CLA (Control Law Accelerator 1)"
	depends on C2000
	help
	  Say Y to clock, reset and gate the CLA1 coprocessor owned by
	  CPU1.  The CLA will be left gated (MSTAT = 0) until CPU1 issues
	  an MSTART command in application code — this prevents spurious
	  execution before the CLA program RAM is loaded.  CLA1 is owned by
	  CPU1 and does not depend on CPU2 being present.

config C2000_CLA2
	bool
	prompt "Enable CPU2 CLA (Control Law Accelerator 2)"
	depends on C2000_SMP_CPU2
	help
	  Say Y to clock, reset and gate CLA2.  Requires CONFIG_C2000_SMP_CPU2.

config C2000_FLASH_PUMP_ACTIVE
	bool
	prompt "Keep Flash pump in active power mode"
	default y
	help
	  When Y, the Flash pump is forced to active mode at boot so the
	  first Flash access does not incur a pump wake-up delay.  Power
	  saving builds may set this to N — the pump sleeps after each
	  access and wakes automatically on the next one.

config C2000_PLL_INIT
	bool
	prompt "Configure PLL to 200 MHz at boot"
	default y
	help
	  Y = write SYSPLLCTL1/SYSPLLMULT/SYSCLKDIVSEL to lock the system
	  PLL on XTAL × 40 / 2 = 200 MHz.  N = leave the clocking as the
	  Boot ROM left it (usually INTOSC1 at 10 MHz).

endmenu
```

## zephyr-c2000-env/zephyr-c2000-staged/port/boards/ti/launchxl_f28379d/board.yml
```yaml
board:
  name: launchxl_f28379d
  full_name: TI LAUNCHXL-F28379D
  vendor: ti
  socs:
  - name: ti_f2837xd
```

## zephyr-c2000-env/zephyr-c2000-staged/port/drivers/serial/Kconfig.f2837xd
```kconfig
# Copyright (c) 2026 Zephyr C2000 port
# SPDX-License-Identifier: Apache-2.0

config UART_F2837XD_SCI
	bool "TI F2837xD SCI-A UART driver"
	default y
	depends on DT_HAS_TI_F2837XD_SCIA_ENABLED
	select SERIAL_HAS_DRIVER
	help
	  Polling driver for the TI TMS320F2837xD SCI-A peripheral.
```

## zephyr-c2000-env/zephyr-c2000-staged/port/drivers/timer/Kconfig.f2837xd
```kconfig
# Copyright (c) 2026 Zephyr C2000 port
# SPDX-License-Identifier: Apache-2.0

config TI_F2837XD_CPUTIMER
	bool "TI F2837xD CPU timer system clock"
	default y
	depends on C2000
	select TICKLESS_CAPABLE
	help
	  Uses CPU timer 0 as the Zephyr system clock.  The timer runs at
	  SYSCLK (200 MHz) and currently generates a fixed 1 ms tick.
```

## zephyr-c2000-env/zephyr-c2000-staged/port/soc/ti/f2837xd/Kconfig
```kconfig
# Copyright (c) 2026 Zephyr C2000 port
# SPDX-License-Identifier: Apache-2.0

config SOC_FAMILY_TI_F2837XD
	bool

config SOC_FAMILY
	default "ti_f2837xd" if SOC_FAMILY_TI_F2837XD

rsource "*/Kconfig.soc"
```

## zephyr-c2000-env/zephyr-c2000-staged/port/soc/ti/f2837xd/f2837xd/Kconfig.defconfig
```kconfig
# Copyright (c) 2026 Zephyr C2000 port
# SPDX-License-Identifier: Apache-2.0

# TI TMS320F2837xD defaults

if SOC_SERIES_F2837XD

config NUM_IRQS
	default 128

config SYS_CLOCK_HW_CYCLES_PER_SEC
	default 200000000

config FLASH_SIZE
	default 0x100000

config SRAM_SIZE
	default 0x32000

endif # SOC_SERIES_F2837XD
```

## zephyr-c2000-env/zephyr-c2000-staged/port/soc/ti/f2837xd/f2837xd/Kconfig.soc
```kconfig
# Copyright (c) 2026 Zephyr C2000 port
# SPDX-License-Identifier: Apache-2.0

config SOC_SERIES_F2837XD
	bool
	select SOC_FAMILY_TI_F2837XD

config SOC_SERIES
	default "f2837xd" if SOC_SERIES_F2837XD

config SOC_TI_F2837XD
	bool
	select SOC_SERIES_F2837XD
	select C2000
	select BUILD_OUTPUT_HEX
	help
	  TI TMS320F2837xD dual-core C28x MCU (200 MHz, 1 MB flash,
	  204 KB RAM per core, FPU32, TMU).

config SOC
	default "ti_f2837xd" if SOC_TI_F2837XD
```

## zephyr-c2000-env/zephyr/boards/ti/launchxl_f28379d/Kconfig.launchxl_f28379d
```kconfig
# Copyright (c) 2026 Zephyr C2000 port
# SPDX-License-Identifier: Apache-2.0

config BOARD_LAUNCHXL_F28379D
	select SOC_TI_F2837XD
	select SOC_EARLY_INIT_HOOK
```

## zephyr-c2000-env/zephyr/dts/bindings/cpu/ti,c28x.yaml
```yaml
# Copyright (c) 2026 Zephyr C2000 port
# SPDX-License-Identifier: Apache-2.0

description: TI C28x CPU node

compatible: "ti,c28x"

include: base.yaml

properties:
  reg:
    required: true
```

## zephyr-c2000-env/zephyr/dts/bindings/serial/ti,f2837xd-scia.yaml
```yaml
# Copyright (c) 2026 Zephyr C2000 port
# SPDX-License-Identifier: Apache-2.0

description: TI TMS320F2837xD SCI (UART)

compatible: "ti,f2837xd-scia"

include: [uart-controller.yaml, base.yaml]

properties:
  reg:
    required: true
  current-speed:
    type: int
    required: true
```

## zephyr-c28x-port/arch/c28x/Kconfig
```kconfig
# TI C2000 (C28x) 架构
#
# Copyright (C) 2026 WWWSKY999. All rights reserved.
#
# C28x 特性：
# - 16 位字架构，22 位地址总线
# - char/int/short 均为 16 位
# - long/指针 为 32 位
# - 目标器件：TMS320F2837xD 系列 (28377D / 28379D)

config ARCH_C28X
	bool "TI C2000 C28x"
	select ATOMIC_OPERATIONS_C
	select ATOMIC_OPERATIONS_BUILTIN
	select HAS_CXX
	select ARCH_C28X_HAS_LINKER_SECTIONS
	help
	  TI C2000 (C28x) DSP 架构支持。
	  C28x 是 16 位字架构，22 位地址总线。
	  char 为 16 位，int 为 16 位，long 为 32 位。
	  本移植针对 TMS320F2837xD 系列，使用 TI C2000 编译器 (cl2000)。

if ARCH_C28X

config ARCH_C28X_UNIFIED_MEMORY
	bool "统一内存模型"
	default y

config ARCH_C28X_HW_FPU
	bool "硬件 FPU (FPU32/FPU64)"
	default y

config ARCH_C28X_LARGE_MODEL
	bool "大内存模型 (far)"
	default y

config ARCH_C28X_HAS_LINKER_SECTIONS
	bool
	default y

config ARCH_C28X_USE_STACK_CANARY
	bool "栈金丝雀支持"
	default n

config ARCH_C28X_SOC_DRIVER
	bool

config ARCH_C28X_SOC_NAME
	string

config ARCH_C28X_SOC_FAMILY
	string

config ARCH_C28X_SMP
	bool "SMP 支持"
	default n
	depends on SMP
	help
	  双核 C28x (CPU1/CPU2) 上的对称多处理支持。

endif # ARCH_C28X
```

## zephyr-c28x-port/boards/ti/f28377d/Kconfig
```kconfig
# TI F28377D 开发板
#
# Copyright (C) 2026 WWWSKY999. All rights reserved.

config BOARD_F28377D
	bool "TI F28377D 开发板"
	select SOC_TI_F2837X
	select BOARD_F28377D
	select BOARD_F2837x_FAMILY
	select BOARD_F2837x_SOC_NAME
	select BOARD_F2837x_SOC_FAMILY
	select BOARD_F2837x_SMP
	help
	  TI TMS320F28377D 开发板支持。
	  基于 TI C2000 C28x 架构，使用 F28377D 芯片。

if BOARD_F28377D

config BOARD_F2837x_FAMILY
	string "F28377D"
	default "F28377D"

config BOARD_F2837x_SOC_NAME
	string "TMS320F28377D"
	default "TMS320F28377D"

config BOARD_F2837x_SOC_FAMILY
	string "F28377D"
	default "F28377D"

config BOARD_F2837x_SMP
	bool "SMP 支持"
	default n
	depends on SMP
	help
	  F28377D 双核 CPU1/CPU2 上的对称多处理支持。

endif # BOARD_F28377D
```

## zephyr-c28x-port/soc/ti/tms320f2837x/Kconfig
```kconfig
# TI TMS320F2837x SoC 支持
#
# Copyright (C) 2026 WWWSKY999. All rights reserved.
#
# F2837xD 是双核 C28x DSP，包含 CPU1 和 CPU2

config SOC_TI_F2837X
	bool "TI TMS320F2837x"
	select ARCH_C28X
	select SOC_TI_F2837X
	select SOC_TI_F2837x_FAMILY
	select SOC_TI_F2837x_SOC_DRIVER
	select SOC_TI_F2837x_SOC_NAME
	select SOC_TI_F2837x_SOC_FAMILY
	select SOC_TI_F2837x_SMP
	help
	  TI TMS320F2837x SoC 支持。
	  F2837xD 是双核 C28x DSP，包含 CPU1 和 CPU2。

if SOC_TI_F2837X

config SOC_TI_F2837x_FAMILY
	string "F2837xD"
	default "F2837xD"

config SOC_TI_F2837x_SOC_NAME
	string "TMS320F2837x"
	default "TMS320F2837x"

config SOC_TI_F2837x_SOC_FAMILY
	string "F2837xD"
	default "F2837xD"

config SOC_TI_F2837x_SMP
	bool "SMP 支持"
	default n
	depends on SMP
	help
	  F2837xD 双核 CPU1/CPU2 上的对称多处理支持。

endif # SOC_TI_F2837X
```
